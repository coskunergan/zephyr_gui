
&flash0 {

	partitions {
		compatible = "fixed-partitions";
		#address-cells = <1>;
		#size-cells = <1>;

		eepromemu_partition: partition@F8000 {
			label = "eeprom-emu";
			reg = <0xF8000 DT_SIZE_K(32)>;
		};		
	};
};